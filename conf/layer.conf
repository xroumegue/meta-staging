## conf/layer.conf
```bitbake
# We have a conf and classes directory, add to BBPATH
BBPATH .= ":${LAYERDIR}"

# We have recipes-* directories, add to BBFILES
BBFILES += "${LAYERDIR}/recipes-*/*/*.bb \
            ${LAYERDIR}/recipes-*/*/*.bbappend"

BBFILE_COLLECTIONS += "meta-staging"
BBFILE_PATTERN_meta-staging = "^${LAYERDIR}/"
BBFILE_PRIORITY_meta-staging = "9"

LAYERDEPENDS_meta-staging = "core"
LAYERSERIES_COMPAT_meta-staging = "kirkstone langdale"
```
